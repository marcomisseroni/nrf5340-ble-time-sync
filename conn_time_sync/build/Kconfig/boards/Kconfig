## conn_time_sync/build/Kconfig/boards/Kconfig
```kconfig
# Load Zephyr board Kconfig descriptions.
osource "/home/m4rch0/ncs/v3.4.1/zephyr/boards/nordic/nrf5340dk/Kconfig"
```

## conn_time_sync/build/conn_time_sync/Kconfig/arch/Kconfig.tmp
```kconfig
# Load Zephyr Arch Kconfig descriptions.
osource "/home/m4rch0/ncs/v3.4.1/zephyr/arch/rx/Kconfig"
osource "/home/m4rch0/ncs/v3.4.1/zephyr/arch/x86/Kconfig"
osource "/home/m4rch0/ncs/v3.4.1/zephyr/arch/xtensa/Kconfig"
osource "/home/m4rch0/ncs/v3.4.1/zephyr/arch/sparc/Kconfig"
osource "/home/m4rch0/ncs/v3.4.1/zephyr/arch/riscv/Kconfig"
osource "/home/m4rch0/ncs/v3.4.1/zephyr/arch/posix/Kconfig"
osource "/home/m4rch0/ncs/v3.4.1/zephyr/arch/openrisc/Kconfig"
osource "/home/m4rch0/ncs/v3.4.1/zephyr/arch/mips/Kconfig"
osource "/home/m4rch0/ncs/v3.4.1/zephyr/arch/arm64/Kconfig"
osource "/home/m4rch0/ncs/v3.4.1/zephyr/arch/arm/Kconfig"
osource "/home/m4rch0/ncs/v3.4.1/zephyr/arch/arc/Kconfig"
```

## conn_time_sync/build/ipc_radio/Kconfig/boards/Kconfig.defconfig
```kconfig
# Load Zephyr board defconfig descriptions.
osource "/home/m4rch0/ncs/v3.4.1/zephyr/boards/nordic/nrf5340dk/Kconfig.defconfig"
```
