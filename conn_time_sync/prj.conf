## CMakeLists.txt
```
#
# Copyright (c) 2024 Nordic Semiconductor
#
# SPDX-License-Identifier: LicenseRef-Nordic-5-Clause
#

cmake_minimum_required(VERSION 3.20.0)
find_package(Zephyr REQUIRED HINTS $ENV{ZEPHYR_BASE})
project(iso_time_sync)

target_include_directories(app PRIVATE include)
target_sources(app PRIVATE src/main.c src/timed_led_toggle.c)

if(CONFIG_BT_CENTRAL)
  target_sources(app PRIVATE src/central.c)
endif()

if(CONFIG_BT_PERIPHERAL)
  target_sources(app PRIVATE src/peripheral.c)
endif()

if(CONFIG_SOC_COMPATIBLE_NRF52X)
  target_sources(app PRIVATE src/controller_time_nrf52.c)
elseif(CONFIG_SOC_COMPATIBLE_NRF5340_CPUAPP)
  target_sources(app PRIVATE src/controller_time_nrf53_app.c)
elseif(CONFIG_SOC_SERIES_NRF54L OR CONFIG_SOC_SERIES_NRF54H)
  target_sources(app PRIVATE src/controller_time_nrf54.c)
else()
  message(FATAL_ERROR "Unsupported series")
endif()

if(DEFINED ENV{CONN_INTERVAL_UNITS})
  set(CONN_INTERVAL_UNITS $ENV{CONN_INTERVAL_UNITS})
else()
  set(CONN_INTERVAL_UNITS 8)
endif()
target_compile_definitions(app PRIVATE CONN_INTERVAL_UNITS=${CONN_INTERVAL_UNITS})
```

## prj.conf
```kconfig
#
# Copyright (c) 2024 Nordic Semiconductor
#
# SPDX-License-Identifier: LicenseRef-Nordic-5-Clause
#

CONFIG_NCS_SAMPLES_DEFAULTS=y

CONFIG_BT_DEVICE_NAME="Conn time sync"
CONFIG_BT=y
CONFIG_BT_PERIPHERAL=y
CONFIG_BT_CENTRAL=y
CONFIG_BT_MAX_CONN=4
CONFIG_BT_CTLR_SDC_PERIPHERAL_COUNT=1

CONFIG_BT_GATT_CLIENT=y
CONFIG_BT_GATT_AUTO_DISCOVER_CCC=y

CONFIG_CONSOLE=y
CONFIG_CONSOLE_SUBSYS=y
CONFIG_CONSOLE_HANDLER=y
CONFIG_CONSOLE_GETCHAR=y

CONFIG_BT_CTLR_SDC_CONN_ANCHOR_POINT_REPORT=y
CONFIG_BT_HCI_VS_EVT_USER=y

CONFIG_NRFX_GPPI=y

CONFIG_BT_L2CAP_TX_MTU=517
CONFIG_BT_BUF_ACL_RX_SIZE=521
CONFIG_BT_GATT_AUTO_UPDATE_MTU=y

CONFIG_BT_DATA_LEN_UPDATE=y
```

## boards/nrf5340dk_nrf5340_cpuapp.overlay
```dts
&led1 {
	gpios = <&gpio1 6 GPIO_ACTIVE_LOW>;
};
```

## include/conn_time_sync.h
```c
/*
 * Copyright (c) 2024 Nordic Semiconductor ASA
 *
 * SPDX-License-Identifier: LicenseRef-Nordic-5-Clause
 */

#ifndef CONN_TIME_SYNC_H__
#define CONN_TIME_SYNC_H__

/**
 * @file
 * @defgroup conn_time_sync Definitions for the connection time sync sample.
 * @{
 * @brief Definitions for the connection time sync sample.
 *
 * This file contains common definitions and API declarations
 * used by the sample.
 */

#include <stdint.h>
#include <stdbool.h>
#include <zephyr/kernel.h>

/** @brief  Timed action service UUID */
#define BT_UUID_TIMED_ACTION_SERVICE_VAL \
	BT_UUID_128_ENCODE(0xA88278D0, 0x7009, 0x4BEE, 0xA6F8, 0xE1DC3FF02B92)
#define BT_UUID_TIMED_ACTION_SERVICE \
	BT_UUID_DECLARE_128(BT_UUID_TIMED_ACTION_SERVICE_VAL)

/** @brief Timed action characteristic UUID */
#define BT_UUID_TIMED_ACTION_CHAR_VAL \
	BT_UUID_128_ENCODE(0xA88278D1, 0x7009, 0x4BEE, 0xA6F8, 0xE1DC3FF02B92)
#define BT_UUID_TIMED_ACTION_CHAR \
	BT_UUID_DECLARE_128(BT_UUID_TIMED_ACTION_CHAR_VAL)

/** @brief  Test data exchange service UUID */
#define BT_UUID_TEST_DATA_SERVICE_VAL \
	BT_UUID_128_ENCODE(0xA88278D2, 0x7009, 0x4BEE, 0xA6F8, 0xE1DC3FF02B92)
#define BT_UUID_TEST_DATA_SERVICE \
	BT_UUID_DECLARE_128(BT_UUID_TEST_DATA_SERVICE_VAL)

/** @brief Test data exchange characteristic UUID */
#define BT_UUID_TEST_DATA_CHAR_VAL \
	BT_UUID_128_ENCODE(0xA88278D3, 0x7009, 0x4BEE, 0xA6F8, 0xE1DC3FF02B92)
#define BT_UUID_TEST_DATA_CHAR \
	BT_UUID_DECLARE_128(BT_UUID_TEST_DATA_CHAR_VAL)

/** @brief Size in bytes of the test data sent with every notification.
 *
 * The first 8 bytes hold a counter, the rest is padding.
 */
#ifndef DATA_SIZE
#define DATA_SIZE 512
#endif
BUILD_ASSERT(DATA_SIZE >= sizeof(uint64_t), "DATA_SIZE must hold the 8-byte counter");

/** @brief Start central demo. */
void central_start(void);

/** @brief Start peripheral demo. */
void peripheral_start(void);

/** @brief The timed action message
 *
 * The timed action message represents the information
 * sent from the central to the peripheral to allow time synchronization.
 * The anchor point information is the common time reference between
 * the central and peripheral.
 *
 * This samples transmits the anchor point time and trigger time
 * in a single packet. Other applications may consider sending those
 * separately.
 */
struct timed_action {
	uint64_t anchor_point_us_central_clock;
	uint16_t anchor_point_event_counter;
	uint64_t trigger_time_us_central_clock;
	bool led_value;
} __packed;

static inline void timed_action_print(struct timed_action *action)
{
	printk("c_anchor point (time=%llu, counter=%u), c_trigger_time %llu, value %d\n",
		action->anchor_point_us_central_clock,
		action->anchor_point_event_counter,
		action->trigger_time_us_central_clock,
		action->led_value);
}

/** @brief Obtain the current Bluetooth controller time.
 *
 * The timestamps are based upon this clock.
 *
 * @return The current controller time.
 */
uint64_t controller_time_us_get(void);

/** @brief Set the controller to trigger a PPI event at the given timestamp.
 *
 * @param timestamp_us The timestamp where it will trigger.
 */
void controller_time_trigger_set(uint64_t timestamp_us);

/** @brief Set a constant offset applied to every trigger.
 *
 * @param offset_ns The offset in nanoseconds. Positive values delay the trigger.
 */
void controller_time_trigger_offset_ns_set(int32_t offset_ns);

/** @brief Get the address of the event that will trigger.
 *
 * @return The address of the event that will trigger.
 */
uint32_t controller_time_trigger_event_addr_get(void);

/** @brief Initialize the module handling timed toggling of an LED.
 *
 * @return 0 on success, failure otherwise.
 */
int timed_led_toggle_init(void);

/** @brief Toggle the LED using the given value at the given timestamp.
 *
 * @param value The LED value.
 * @param timestamp_us The time when the LED will be set, in microseconds.
 *                     The time is specified in controller clock units.
 */
void timed_led_toggle_trigger_at(uint8_t value, uint32_t timestamp_us);

#endif

/**
 * @}
 */
```

## src/central.c
```c
/*
 * Copyright (c) 2024 Nordic Semiconductor ASA
 *
 * SPDX-License-Identifier: LicenseRef-Nordic-5-Clause
 */

#include <zephyr/sys/atomic.h>
#include <zephyr/bluetooth/bluetooth.h>
#include <zephyr/bluetooth/conn.h>
#include <zephyr/bluetooth/hci.h>
#include <bluetooth/services/nus.h>
#include "conn_time_sync.h"
#include <bluetooth/hci_vs_sdc.h>

/* Connection interval, in units of 1.25 ms (BT_LE_CONN_PARAM's own units).
 * Change only this to sweep the sync frequency; everything below derives
 * from it and stays valid for any 6 <= N <= 3200 (the spec's own bounds).
 */
//#define CONN_INTERVAL_UNITS 3200
#define CONN_INTERVAL_US    (CONN_INTERVAL_UNITS * 1250)

/* Same N, but interpreted in units of 10 ms for the supervision timeout:
 * timeout_ms = 10 * N is always 8x the interval (1.25 * N), comfortably
 * above the 2x the Bluetooth spec requires (timeout_ms > 2 * interval_ms).
 * Below N=10 that would put the timeout under the spec's own 100 ms floor
 * for this parameter (independent of the interval), so clamp it there.
 */
#define CONN_TIMEOUT_UNITS ((CONN_INTERVAL_UNITS) > 10 ? (CONN_INTERVAL_UNITS) : 10)

/* Must stay above the connection interval, otherwise the toggle command is
 * already stale by the time it reaches the peripheral (see peripheral.c's
 * "controller_time_us + 500 < trigger_time_local" check), and below
 * LED_TOGGLE_PERIOD_MS, otherwise the central re-arms its own pending
 * trigger before it ever fires.
 *
 * A pure 2x/4x-the-interval margin collapses to almost nothing at small N
 * (e.g. 7.5 ms of offset slack at N=6), which isn't enough to absorb the
 * scheduling jitter of servicing multiple simultaneous peripherals - one
 * missed connection event for that link and the command is already late.
 * The original sample's fixed values at its 10 ms default interval -
 * 50 ms offset, 120 ms period - are known to work, so floor both exactly
 * there regardless of N, and only let them grow past that (2x/4x the
 * interval) once N is large enough that the proportional value exceeds it.
 */
#define LED_TOGGLE_TIME_OFFSET_US \
	((CONN_INTERVAL_US * 2) > 50000 ? (CONN_INTERVAL_US * 2) : 50000)
#define LED_TOGGLE_PERIOD_MS \
	((CONN_INTERVAL_US * 4 / 1000) > 120 ? (CONN_INTERVAL_US * 4 / 1000) : 120)

#define ADV_NAME_STR_MAX_LEN (sizeof(CONFIG_BT_DEVICE_NAME))

static void scan_start(void);

static bool led_value;
static uint8_t volatile conn_count;

static const struct bt_uuid *timed_char_uuid = BT_UUID_TIMED_ACTION_CHAR;
static const struct bt_uuid *data_exch_char_uuid = BT_UUID_TEST_DATA_CHAR;

static struct {
	atomic_t last_anchor_point_in_use;
	uint16_t timed_action_char_handle;
	uint16_t last_anchor_point_event_counter;
	uint64_t last_anchor_point_timestamp;
	struct timed_action timed_action_msg;
	struct bt_gatt_discover_params discovery_params;
	uint16_t data_exch_char_handle;
	struct bt_gatt_discover_params data_exch_discovery_params;
} conn_state[CONFIG_BT_MAX_CONN];

/* Kept outside conn_state, which is zeroed on disconnection, because the Bluetooth
 * stack holds on to the subscription parameters while the subscription is active.
 */
static struct bt_gatt_subscribe_params data_exch_subscribe_params[CONFIG_BT_MAX_CONN];
static struct bt_gatt_discover_params data_exch_ccc_discovery_params[CONFIG_BT_MAX_CONN];

static void send_timestamp_to_peripheral(struct bt_conn *conn, void *data)
{
	int err;
	struct bt_conn_info conn_info;
	uint64_t toggle_time_us = *(uint64_t *)data;

	err = bt_conn_get_info(conn, &conn_info);
	if (err) {
		return;
	}

	uint8_t conn_index = bt_conn_index(conn);

	if (conn_info.state != BT_CONN_STATE_CONNECTED) {
		return;
	}

	if (conn_state[conn_index].timed_action_char_handle == 0) {
		/* Service discovery not yet complete. */
		return;
	}

	if (atomic_test_and_set_bit(&conn_state[conn_index].last_anchor_point_in_use, 0)) {
		return;
	}

	conn_state[conn_index].timed_action_msg.anchor_point_us_central_clock =
		conn_state[conn_index].last_anchor_point_timestamp;
	conn_state[conn_index].timed_action_msg.anchor_point_event_counter =
		conn_state[conn_index].last_anchor_point_event_counter;
	conn_state[conn_index].timed_action_msg.trigger_time_us_central_clock = toggle_time_us;
	conn_state[conn_index].timed_action_msg.led_value = led_value;

	atomic_clear_bit(&conn_state[conn_index].last_anchor_point_in_use, 0);

	err = bt_gatt_write_without_response(conn,
		conn_state[conn_index].timed_action_char_handle,
		&conn_state[conn_index].timed_action_msg,
		sizeof(struct timed_action),
		false);
	if (err) {
		printk("Failed writing to characteristic\n");
	} else {
		printk("Sent to conn index %d: ", conn_index);
		timed_action_print(&conn_state[conn_index].timed_action_msg);
	}
}

static void on_timestamp_send_timeout(struct k_work *work)
{
	uint64_t local_time_us = controller_time_us_get();
	uint64_t toggle_time_us = local_time_us + LED_TOGGLE_TIME_OFFSET_US;

	led_value = !led_value;

	timed_led_toggle_trigger_at(led_value, toggle_time_us);

	bt_conn_foreach(BT_CONN_TYPE_LE, send_timestamp_to_peripheral, &toggle_time_us);

	k_work_schedule(k_work_delayable_from_work(work), K_MSEC(LED_TOGGLE_PERIOD_MS));
}

K_WORK_DELAYABLE_DEFINE(timestamp_send_work, on_timestamp_send_timeout);

static bool adv_data_parse_cb(struct bt_data *data, void *user_data)
{
	char *name = user_data;
	uint8_t len;

	switch (data->type) {
	case BT_DATA_NAME_SHORTENED:
	case BT_DATA_NAME_COMPLETE:
		len = MIN(data->data_len, ADV_NAME_STR_MAX_LEN - 1);
		memcpy(name, data->data, len);
		name[len] = '\0';
		return false;
	default:
		return true;
	}
}

static void device_found(const bt_addr_le_t *addr, int8_t rssi, uint8_t type,
			 struct net_buf_simple *ad)
{
	char name_str[ADV_NAME_STR_MAX_LEN] = {0};
	char addr_str[BT_ADDR_LE_STR_LEN];
	int err;

	/* We're only interested in connectable events */
	if (type != BT_GAP_ADV_TYPE_ADV_IND &&
	    type != BT_GAP_ADV_TYPE_ADV_DIRECT_IND) {
		return;
	}

	bt_data_parse(ad, adv_data_parse_cb, name_str);

	if (strncmp(name_str, CONFIG_BT_DEVICE_NAME, ADV_NAME_STR_MAX_LEN) != 0) {
		return;
	}

	bt_addr_le_to_str(addr, addr_str, sizeof(addr_str));
	printk("Device found: %s (RSSI %d)\n", addr_str, rssi);

	if (bt_le_scan_stop()) {
		return;
	}

	struct bt_conn *unused_conn = NULL;

	err = bt_conn_le_create(addr, BT_CONN_LE_CREATE_CONN,
				BT_LE_CONN_PARAM(CONN_INTERVAL_UNITS, CONN_INTERVAL_UNITS, 0,
						 CONN_TIMEOUT_UNITS), &unused_conn);
	if (err) {
		printk("Create conn to %s failed (%d)\n", addr_str, err);
		scan_start();
	}

	if (unused_conn) {
		bt_conn_unref(unused_conn);
	}
}

static void scan_start(void)
{
	int err;

	err = bt_le_scan_start(BT_LE_SCAN_ACTIVE_CONTINUOUS, device_found);
	if (err) {
		printk("Scanning failed to start (err %d)\n", err);
		return;
	}

	printk("Scanning started\n");
}

static uint8_t on_data_notify(struct bt_conn *conn,
	struct bt_gatt_subscribe_params *params,
	const void *data, uint16_t length)
{
	uint64_t counter;

	if (data == NULL) {
		printk("Data exchange: unsubscribed\n");
		return BT_GATT_ITER_STOP;
	}

	if (length != DATA_SIZE) {
		printk("Data exchange: unexpected length %u\n", length);
		return BT_GATT_ITER_CONTINUE;
	}

	/* The counter is in the first 8 bytes, the rest is padding. */
	memcpy(&counter, data, sizeof(counter));
	printk("Data exchange: received %llu\n", counter);

	return BT_GATT_ITER_CONTINUE;
}

static void on_data_subscribed(struct bt_conn *conn, uint8_t err,
	struct bt_gatt_subscribe_params *params)
{
	if (err) {
		printk("Data exchange subscription failed, ATT error 0x%02x\n", err);
	} else {
		printk("Data exchange subscription completed\n");
	}
}

static uint8_t on_service_discover(struct bt_conn *conn,
	const struct bt_gatt_attr *attr,
	struct bt_gatt_discover_params *params)
{
	uint8_t conn_index = bt_conn_index(conn);
	int err;

	/* Discovery of the data exchange characteristic: subscribe to it once found. */
	if (params == &conn_state[conn_index].data_exch_discovery_params) {
		struct bt_gatt_subscribe_params *sub = &data_exch_subscribe_params[conn_index];

		if (!attr) {
			printk("Data exchange discovery failed\n");
			return BT_GATT_ITER_STOP;
		}

		conn_state[conn_index].data_exch_char_handle = bt_gatt_attr_value_handle(attr);
		printk("Data exchange discovery completed\n");

		memset(sub, 0, sizeof(*sub));
		atomic_set_bit(sub->flags, BT_GATT_SUBSCRIBE_FLAG_VOLATILE);
		sub->notify = on_data_notify;
		sub->subscribe = on_data_subscribed;
		sub->value_handle = conn_state[conn_index].data_exch_char_handle;
		/* CCC handle unknown: let the stack discover it. */
		sub->ccc_handle = BT_GATT_AUTO_DISCOVER_CCC_HANDLE;
		sub->end_handle = BT_ATT_LAST_ATTRIBUTE_HANDLE;
		sub->disc_params = &data_exch_ccc_discovery_params[conn_index];
		sub->value = BT_GATT_CCC_NOTIFY;

		err = bt_gatt_subscribe(conn, sub);
		if (err) {
			printk("Data exchange subscribe request failed, %d\n", err);
		}

		return BT_GATT_ITER_STOP;
	}

	/* Discovery of the timed action characteristic (sync). */
	if (attr) {
		conn_state[conn_index].timed_action_char_handle =
			bt_gatt_attr_value_handle(attr);
		printk("Service discovery completed\n");
	} else {
		printk("Service discovery failed\n");
	}

	/* Only one discovery at a time per connection: start the next one now. */
	err = bt_gatt_discover(conn, &conn_state[conn_index].data_exch_discovery_params);
	if (err) {
		printk("Discovery for data exchange failed, %d\n", err);
	}

	return BT_GATT_ITER_STOP;
}

static void connected(struct bt_conn *conn, uint8_t err)
{
	char addr[BT_ADDR_LE_STR_LEN];

	bt_addr_le_to_str(bt_conn_get_dst(conn), addr, sizeof(addr));

	if (err) {
		printk("Failed to connect to %s 0x%02x %s\n", addr, err, bt_hci_err_to_str(err));

		scan_start();
		return;
	}

	printk("Connected: %s\n", addr);

	uint8_t conn_index = bt_conn_index(conn);

	conn_state[conn_index].discovery_params.uuid = timed_char_uuid;
	conn_state[conn_index].discovery_params.func = on_service_discover;
	conn_state[conn_index].discovery_params.start_handle = BT_ATT_FIRST_ATTRIBUTE_HANDLE;
	conn_state[conn_index].discovery_params.end_handle = BT_ATT_LAST_ATTRIBUTE_HANDLE;
	conn_state[conn_index].discovery_params.type = BT_GATT_DISCOVER_CHARACTERISTIC;

	conn_state[conn_index].data_exch_discovery_params.uuid = data_exch_char_uuid;
	conn_state[conn_index].data_exch_discovery_params.func = on_service_discover;
	conn_state[conn_index].data_exch_discovery_params.start_handle = BT_ATT_FIRST_ATTRIBUTE_HANDLE;
	conn_state[conn_index].data_exch_discovery_params.end_handle = BT_ATT_LAST_ATTRIBUTE_HANDLE;
	conn_state[conn_index].data_exch_discovery_params.type = BT_GATT_DISCOVER_CHARACTERISTIC;

	err = bt_gatt_discover(conn, &conn_state[conn_index].discovery_params);
	if (err) {
		printk("Discovery failed, %d\n", err);
	}

	const uint8_t peripheral_conn_count = 1;

	conn_count++;
	if (conn_count < CONFIG_BT_MAX_CONN - peripheral_conn_count) {
		scan_start();
	}
}

static void disconnected(struct bt_conn *conn, uint8_t reason)
{
	char addr[BT_ADDR_LE_STR_LEN];

	bt_addr_le_to_str(bt_conn_get_dst(conn), addr, sizeof(addr));

	printk("Disconnected: %s, reason 0x%02x %s\n", addr, reason, bt_hci_err_to_str(reason));

	conn_count--;

	uint8_t conn_index = bt_conn_index(conn);

	/* Reset state */
	memset(&conn_state[conn_index], 0, sizeof(conn_state[0]));

	const uint8_t peripheral_conn_count = 1;

	if (conn_count == CONFIG_BT_MAX_CONN - peripheral_conn_count - 1) {
		scan_start();
	}
}

static bool on_conn_param_req(struct bt_conn *conn, struct bt_le_conn_param *param)
{
	ARG_UNUSED(conn);
	ARG_UNUSED(param);

	return false;
}

static struct bt_conn_cb conn_callbacks = {
	.connected = connected,
	.disconnected = disconnected,
	.le_param_req = on_conn_param_req,
};

static bool on_vs_evt(struct net_buf_simple *buf)
{
	uint8_t *subevent_code;
	struct bt_conn *conn;
	sdc_hci_subevent_vs_conn_anchor_point_update_report_t *evt = NULL;

	subevent_code = net_buf_simple_pull_mem(
		buf,
		sizeof(*subevent_code));

	switch (*subevent_code) {
	case SDC_HCI_SUBEVENT_VS_CONN_ANCHOR_POINT_UPDATE_REPORT:
		evt = (void *)buf->data;
		break;
	default:
		return false;
	}

	if (!evt) {
		return false;
	}

	conn = bt_hci_conn_lookup_handle(evt->conn_handle);
	if (!conn) {
		return true;
	}

	uint8_t conn_index = bt_conn_index(conn);

	bt_conn_unref(conn);
	conn = NULL;

	if (atomic_test_and_set_bit(&conn_state[conn_index].last_anchor_point_in_use, 0)) {
		return true;
	}

	conn_state[conn_index].last_anchor_point_timestamp = evt->anchor_point_us;
	conn_state[conn_index].last_anchor_point_event_counter = evt->event_counter;

	atomic_clear_bit(&conn_state[conn_index].last_anchor_point_in_use, 0);

	return true;
}

void central_start(void)
{
	int err;

	err = bt_enable(NULL);
	if (err) {
		printk("Bluetooth init failed (err %d)\n", err);
		return;
	}

	err = bt_hci_register_vnd_evt_cb(on_vs_evt);
	if (err) {
		printk("Failed to register HCI VS callback\n");
		return;
	}

	sdc_hci_cmd_vs_conn_anchor_point_update_event_report_enable_t enable_params = {
		.enable = true
	};

	err = hci_vs_sdc_conn_anchor_point_update_event_report_enable(&enable_params);
	if (err) {
		printk("Failed to enable connection anchor point update events\n");
		return;
	}

	timed_led_toggle_init();

	bt_conn_cb_register(&conn_callbacks);

	scan_start();

	k_work_schedule(&timestamp_send_work, K_MSEC(LED_TOGGLE_PERIOD_MS));
}
```

## src/controller_time_nrf53_app.c
```c
/*
 * Copyright (c) 2024 Nordic Semiconductor ASA
 *
 * SPDX-License-Identifier: LicenseRef-Nordic-5-Clause
 */

/** This file implements controller time management for 53 Series devices
 *
 * As the controller clock is not directly accessible, the controller
 * time is obtained using a mirrored RTC peripheral.
 * The RTC is started upon starting the controller clock on the network core.
 * To achieve microsecond accurate toggling, a timer peripheral is also used.
 */

#include <zephyr/kernel.h>
#include <zephyr/init.h>
#include <zephyr/sys/barrier.h>
#include <helpers/nrfx_gppi.h>
#include <nrfx_rtc.h>
#include <nrfx_timer.h>
#include <hal/nrf_ipc.h>
#include <hal/nrf_egu.h>
#include <zephyr/drivers/clock_control.h>
#include <zephyr/drivers/clock_control/nrf_clock_control.h>
#include "conn_time_sync.h"

/* Keep the HFXO crystal running on the application core, so that the TIMER
 * counts with the crystal instead of the internal RC oscillator (HFINT).
 * Set to 0 to compare against the default behavior.
 */
#define USE_HFXO 1

static nrfx_rtc_t app_rtc_instance = NRFX_RTC_INSTANCE(NRF_RTC0);
static nrfx_timer_t app_timer_instance = NRFX_TIMER_INSTANCE(NRF_TIMER0);

static nrfx_gppi_handle_t ppi_on_rtc_match;
static volatile uint32_t num_rtc_overflows;

static void rtc_isr_handler(nrf_rtc_event_t event_type, void *ctx)
{
	ARG_UNUSED(ctx);

	if (event_type == NRF_RTC_EVENT_OVERFLOW) {
		num_rtc_overflows++;
	}
}

static void unused_timer_isr_handler(nrf_timer_event_t event_type, void *ctx)
{
	ARG_UNUSED(event_type);
	ARG_UNUSED(ctx);
}

static int rtc_config(void)
{
	int ret;
	nrfx_gppi_handle_t dppi_rtc_start;
	const nrfx_rtc_config_t rtc_cfg = NRFX_RTC_DEFAULT_CONFIG;

	ret = nrfx_rtc_init(&app_rtc_instance, &rtc_cfg, rtc_isr_handler);
	if (ret != 0) {
		printk("Failed initializing RTC (ret: %d)\n", ret);
		return -ENODEV;
	}

#ifndef CONFIG_SOC_SERIES_BSIM_NRFXX
	IRQ_CONNECT(NRFX_IRQ_NUMBER_GET(NRF_RTC_INST_GET(0)), IRQ_PRIO_LOWEST,
		    nrfx_rtc_irq_handler, &app_rtc_instance, 0);
#else
	IRQ_CONNECT(NRFX_IRQ_NUMBER_GET(NRF_RTC_INST_GET(0)), 0,
		    (void *)nrfx_rtc_irq_handler, &app_rtc_instance, 0);
#endif

	nrfx_rtc_overflow_enable(&app_rtc_instance, true);
	nrfx_rtc_tick_enable(&app_rtc_instance, false);
	nrfx_rtc_enable(&app_rtc_instance);

	nrf_ipc_receive_config_set(NRF_IPC, 4, NRF_IPC_CHANNEL_4);
	/* The application core RTC is started synchronously with the controller
	 * RTC using PPI over IPC.
	 */
	ret = nrfx_gppi_conn_alloc(nrfx_rtc_task_address_get(&app_rtc_instance, NRF_RTC_TASK_CLEAR),
				   nrf_ipc_event_address_get(NRF_IPC, NRF_IPC_EVENT_RECEIVE_4),
				   &dppi_rtc_start);
	if (ret < 0) {
		printk("nrfx DPPI channel alloc error for starting RTC: %d", ret);
		return ret;
	}
	nrfx_gppi_conn_enable(dppi_rtc_start);

	return 0;
}

static int timer_config(void)
{
	int ret;
	nrfx_gppi_handle_t ppi_timer_clear_on_rtc_tick;
	const nrfx_timer_config_t timer_cfg = {
		//.frequency = NRFX_MHZ_TO_HZ(1UL),
		.frequency = NRFX_MHZ_TO_HZ(16),
		.mode = NRF_TIMER_MODE_TIMER,
		//.bit_width = NRF_TIMER_BIT_WIDTH_8,
		.bit_width = NRF_TIMER_BIT_WIDTH_16,
		.interrupt_priority = NRFX_TIMER_DEFAULT_CONFIG_IRQ_PRIORITY,
		.p_context = NULL};
	uint32_t eep = nrfx_rtc_event_address_get(&app_rtc_instance, NRF_RTC_EVENT_TICK);
	uint32_t tep = nrfx_timer_task_address_get(&app_timer_instance, NRF_TIMER_TASK_CLEAR);

	ret = nrfx_timer_init(&app_timer_instance, &timer_cfg, unused_timer_isr_handler);
	if (ret != 0) {
		printk("Failed initializing timer (ret: %d)\n", ret);
		return -ENODEV;
	}

	ret = nrfx_gppi_conn_alloc(eep, tep, &ppi_timer_clear_on_rtc_tick);
	if (ret < 0) {
		printk("Failed allocating for clearing TIMER on RTC TICK\n");
		return ret;
	}

	nrfx_gppi_conn_enable(ppi_timer_clear_on_rtc_tick);
	nrfx_timer_enable(&app_timer_instance);

	return 0;
}

/** Configure the TIMER and RTC in such a way that microsecond accurate timing can be achieved.
 *
 * To get microsecond accurate toggling, we need to combine both the RTC and TIMER peripheral.
 * That is, both a RTC CC value and TIMER CC value needs to be set.
 * We should only trigger an EGU task when the TIMER CC value
 * matches after the RTC CC value matched.
 * This is achieved using a PPI group. The group is enabled when the RTC CC matches and disabled
 * again then the TIMER CC matches.
 */
int config_egu_trigger_on_rtc_and_timer_match(void)
{
	nrfx_gppi_handle_t ppi_on_timer_match;
	nrfx_gppi_group_handle_t group;
	uint32_t eep0 = nrfx_rtc_event_address_get(&app_rtc_instance, NRF_RTC_EVENT_COMPARE_0);
	uint32_t eep1 = nrfx_timer_event_address_get(&app_timer_instance, NRF_TIMER_EVENT_COMPARE0);
	uint32_t tep1 = nrf_egu_task_address_get(NRF_EGU0, NRF_EGU_TASK_TRIGGER0);
	int ret;

	ret = nrfx_gppi_group_alloc(nrfx_gppi_domain_id_get(eep0), &group);
	if (ret < 0) {
		printk("Failed allocating group\n");
		return ret;
	}

	ret = nrfx_gppi_conn_alloc(eep0, nrfx_gppi_group_task_en_addr(group), &ppi_on_rtc_match);
	if (ret < 0) {
		printk("Failed allocating for RTC match\n");
		return ret;
	}

	ret = nrfx_gppi_group_ep_add(group, eep0);
	if (ret < 0) {
		printk("Failed attaching an event to the group (ret: %d)\n", ret);
		return ret;
	}

	ret = nrfx_gppi_conn_alloc(eep1, tep1, &ppi_on_timer_match);
	if (ret < 0) {
		printk("Failed allocating for RTC match\n");
		return ret;
	}

	ret = nrfx_gppi_ep_attach(nrfx_gppi_group_task_dis_addr(group), ppi_on_timer_match);
	if (ret < 0) {
		printk("Failed attaching disable task to timer match channel (ret: %d)\n", ret);
		return ret;
	}

	ret = nrfx_gppi_group_ep_add(group, eep1);
	if (ret < 0) {
		printk("Failed attaching timer match event to the group (ret: %d)\n", ret);
		return ret;
	}

	return 0;
}

static int hfxo_start(void)
{
	int err;
	int res;
	struct onoff_manager *clk_mgr;
	struct onoff_client clk_cli;

	clk_mgr = z_nrf_clock_control_get_onoff(CLOCK_CONTROL_NRF_SUBSYS_HF);
	if (!clk_mgr) {
		printk("Unable to get the clock manager\n");
		return -ENODEV;
	}

	sys_notify_init_spinwait(&clk_cli.notify);

	err = onoff_request(clk_mgr, &clk_cli);
	if (err < 0) {
		printk("HFXO request failed (err: %d)\n", err);
		return err;
	}

	/* The request is never released, so the HFXO stays on. */
	do {
		err = sys_notify_fetch_result(&clk_cli.notify, &res);
		if (!err && res) {
			printk("HFXO could not be started (res: %d)\n", res);
			return res;
		}
	} while (err);

	return 0;
}

int controller_time_init(void)
{
	int ret;

	if (USE_HFXO) {
		ret = hfxo_start();
		if (ret) {
			return ret;
		}
	}

	ret = rtc_config();
	if (ret) {
		return ret;
	}

	ret = timer_config();
	if (ret) {
		return ret;
	}

	return config_egu_trigger_on_rtc_and_timer_match();
}

static uint64_t rtc_ticks_to_us(uint32_t rtc_ticks)
{
	const uint64_t rtc_ticks_in_femto_units = 30517578125UL;

	return (rtc_ticks * rtc_ticks_in_femto_units) / 1000000000UL;
}

uint64_t controller_time_us_get(void)
{
	/* Simply use the RTC time here.
	 * It is possible to combine RTC and TIMER information here to get a more accurate
	 * timestamp. That requires setting up a PPI channel to capture both values simultaneously.
	 */

	const uint64_t rtc_overflow_time_us = 512000000UL;

	uint32_t captured_rtc_overflows;
	uint32_t captured_rtc_ticks;

	while (true) {
		captured_rtc_overflows = num_rtc_overflows;

		/* Read out RTC ticks after reading number of overflows. */
		barrier_isync_fence_full();

		captured_rtc_ticks = nrf_rtc_counter_get(app_rtc_instance.p_reg);

		/* Read out number of overflows after reading number of RTC ticks  */
		barrier_isync_fence_full();

		if (captured_rtc_overflows == num_rtc_overflows) {
			/* There were no new overflows after reading ticks.
			 * That is, we can use the captured value.
			 */
			break;
		}
	}

	return rtc_ticks_to_us(captured_rtc_ticks) +
	       (captured_rtc_overflows * rtc_overflow_time_us);
}

static int32_t trigger_offset_ns;

void controller_time_trigger_offset_ns_set(int32_t offset_ns)
{
	trigger_offset_ns = offset_ns;
}

void controller_time_trigger_set(uint64_t timestamp_us)
{
	const uint64_t rtc_ticks_in_femto_units = 30517578125UL;

	/* Work in ns so that the sub-µs offset is not lost. */
	uint64_t timestamp_ns = timestamp_us * 1000UL + trigger_offset_ns;

	uint32_t num_overflows = timestamp_ns / 512000000000ULL;
	uint64_t remainder_ns = timestamp_ns - num_overflows * 512000000000ULL;

	uint32_t rtc_val = (remainder_ns * 1000000UL) / rtc_ticks_in_femto_units;

	/* Exact start time of the RTC tick, in ns. */
	uint64_t rtc_tick_start_ns = ((uint64_t)rtc_val * rtc_ticks_in_femto_units) / 1000000UL;

	/* TIMER runs at 16 MHz: 1 count = 62.5 ns. */
	uint16_t timer_val = ((remainder_ns - rtc_tick_start_ns) * 16UL) / 1000UL;

	/* Keep the timer value away from the edges of the RTC tick (30.52 µs = ~488 counts).
	 * The TIMER is cleared and the PPI group is enabled by two different RTC events.
	 * If the group is enabled just before the clear, a compare value close to the end
	 * of the tick would match in the previous tick and trigger one RTC tick too early.
	 */
	timer_val = MAX(timer_val, 8);   /* 0.5 µs after the RTC tick */
	timer_val = MIN(timer_val, 480); /* ~0.5 µs before the next RTC tick */

	if (nrfx_rtc_cc_set(&app_rtc_instance, 0, rtc_val, false) != 0) {
		printk("Failed setting trigger\n");
	}

	nrfx_timer_compare(&app_timer_instance, 0, timer_val, false);
	nrfx_gppi_conn_enable(ppi_on_rtc_match);
}

uint32_t controller_time_trigger_event_addr_get(void)
{
	return nrf_egu_event_address_get(NRF_EGU0, NRF_EGU_EVENT_TRIGGERED0);
}

/* The controller time initialization must happen before
 * starting the network core.
 */
SYS_INIT(controller_time_init, POST_KERNEL, CONFIG_KERNEL_INIT_PRIORITY_DEFAULT);
```

## src/peripheral.c
```c
/*
 * Copyright (c) 2024 Nordic Semiconductor ASA
 *
 * SPDX-License-Identifier: LicenseRef-Nordic-5-Clause
 */

#include <zephyr/sys/atomic.h>
#include <zephyr/bluetooth/bluetooth.h>
#include <zephyr/bluetooth/conn.h>
#include <zephyr/bluetooth/hci.h>
#include <bluetooth/services/nus.h>
#include <bluetooth/services/nus_client.h>
#include <bluetooth/hci_vs_sdc.h>

#include "conn_time_sync.h"

#define PERIPHERAL_TRIGGER_CORRECTION_NS 0

// Data exchange;
static uint8_t payload[DATA_SIZE];

static ssize_t test_data_received(struct bt_conn *conn,
					     const struct bt_gatt_attr *attr,
					     void *buf, uint16_t len,
					     uint16_t offset)
{
	return bt_gatt_attr_read(conn, attr, buf, len, offset, &payload, sizeof(payload));
}

static bool test_data_notify_enabled;

static void test_data_ccc_changed(const struct bt_gatt_attr *attr, uint16_t value)
{
	test_data_notify_enabled = (value == BT_GATT_CCC_NOTIFY);
	printk("Data exchange notifications %s\n",
	       test_data_notify_enabled ? "enabled" : "disabled");
}

BT_GATT_SERVICE_DEFINE(test_data_service,
	BT_GATT_PRIMARY_SERVICE(BT_UUID_TEST_DATA_SERVICE),
	BT_GATT_CHARACTERISTIC(BT_UUID_TEST_DATA_CHAR,
		BT_GATT_CHRC_READ | BT_GATT_CHRC_NOTIFY,
		BT_GATT_PERM_READ, test_data_received, NULL, NULL),
	BT_GATT_CCC(test_data_ccc_changed, BT_GATT_PERM_READ | BT_GATT_PERM_WRITE));

static void test_data_notify_work_handler(struct k_work *work)
{
	int err;
	uint64_t counter;

	/* The counter in the first 8 bytes changes at every notification, so
	 * that the central can see whether one is missing.
	 */
	memcpy(&counter, payload, sizeof(counter));
	counter++;
	memcpy(payload, &counter, sizeof(counter));

	/* NULL connection: notify every subscribed connection. */
	err = bt_gatt_notify_uuid(NULL, BT_UUID_TEST_DATA_CHAR, test_data_service.attrs,
				  &payload, sizeof(payload));
	if (err) {
		printk("Data exchange notify failed, %d\n", err);
	}
}

K_WORK_DEFINE(test_data_notify_work, test_data_notify_work_handler);

static const struct bt_data ad[] = {
	BT_DATA_BYTES(BT_DATA_FLAGS, (BT_LE_AD_GENERAL | BT_LE_AD_NO_BREDR)),
	BT_DATA(BT_DATA_NAME_COMPLETE, CONFIG_BT_DEVICE_NAME, sizeof(CONFIG_BT_DEVICE_NAME) - 1),
};

static atomic_t last_timed_action_in_use;
static struct timed_action last_timed_action;

static uint32_t conn_interval_us_get(const struct bt_conn *conn)
{
	struct bt_conn_info info;

	if (bt_conn_get_info(conn, &info)) {
		return 0;
	}

	return info.le.interval_us;
}

static ssize_t time_sync_data_received(struct bt_conn *conn,
					     const struct bt_gatt_attr *attr,
					     const void *buf, uint16_t len,
					     uint16_t offset, uint8_t flags)
{
	__ASSERT_NO_MSG(len == sizeof(struct timed_action));
	__ASSERT_NO_MSG(offset == 0);

	struct timed_action *params = (void *)buf;

	__ASSERT_NO_MSG(params->trigger_time_us_central_clock >
			params->anchor_point_us_central_clock);

	if (!atomic_test_and_set_bit(&last_timed_action_in_use, 0)) {
		memcpy(&last_timed_action, params, sizeof(*params));
		atomic_clear_bit(&last_timed_action_in_use, 0);
	}

	printk("Received: ");

	timed_action_print(params);

	return len;
}

BT_GATT_SERVICE_DEFINE(timed_toggle_service,
	BT_GATT_PRIMARY_SERVICE(BT_UUID_TIMED_ACTION_SERVICE),
	BT_GATT_CHARACTERISTIC(BT_UUID_TIMED_ACTION_CHAR,
		BT_GATT_CHRC_WRITE_WITHOUT_RESP,
		BT_GATT_PERM_READ | BT_GATT_PERM_WRITE, NULL, time_sync_data_received, NULL));

static void adv_start(void)
{
	int err;

	err = bt_le_adv_start(BT_LE_ADV_CONN_FAST_2, ad, ARRAY_SIZE(ad), NULL, 0);
	if (err) {
		printk("Advertising failed to start (err %d)\n", err);
		return;
	}

	printk("Advertising started\n");
}

static void connected(struct bt_conn *conn, uint8_t err)
{
	char addr[BT_ADDR_LE_STR_LEN];

	bt_addr_le_to_str(bt_conn_get_dst(conn), addr, sizeof(addr));

	if (err) {
		printk("Failed to connect to %s 0x%02x %s\n", addr, err, bt_hci_err_to_str(err));

		adv_start();
		return;
	}

	printk("Connected: %s\n", addr);
}

static void disconnected(struct bt_conn *conn, uint8_t reason)
{
	char addr[BT_ADDR_LE_STR_LEN];

	bt_addr_le_to_str(bt_conn_get_dst(conn), addr, sizeof(addr));

	test_data_notify_enabled = false;

	printk("Disconnected: %s, reason 0x%02x %s\n", addr, reason, bt_hci_err_to_str(reason));

	adv_start();
}

static struct bt_conn_cb conn_callbacks = {
	.connected = connected,
	.disconnected = disconnected,
};

static uint64_t central_timestamp_to_local_clock(uint64_t central_timestamp_us,
						 uint32_t conn_interval_us,
						 uint64_t central_anchor_us,
						 uint64_t peripheral_anchor_us,
						 uint16_t central_event_count,
						 uint16_t peripheral_event_count)
{
	int32_t event_counter_diff = central_event_count - peripheral_event_count;
	int32_t anchor_point_time_diff_us = event_counter_diff * conn_interval_us;
	uint64_t peripheral_time_us_at_central_anchor =
		peripheral_anchor_us + anchor_point_time_diff_us;
	int64_t anchor_to_timestamp = central_timestamp_us - central_anchor_us;

	return peripheral_time_us_at_central_anchor + anchor_to_timestamp;
}

static bool on_vs_evt(struct net_buf_simple *buf)
{
	uint8_t *subevent_code;
	struct bt_conn *conn;
	sdc_hci_subevent_vs_conn_anchor_point_update_report_t *evt = NULL;

	subevent_code = net_buf_simple_pull_mem(
		buf,
		sizeof(*subevent_code));

	switch (*subevent_code) {
	case SDC_HCI_SUBEVENT_VS_CONN_ANCHOR_POINT_UPDATE_REPORT:
		evt = (void *)buf->data;
		break;
	default:
		return false;
	}

	if (!evt) {
		return false;
	}

	conn = bt_hci_conn_lookup_handle(evt->conn_handle);
	if (!conn) {
		return true;
	}

	uint32_t conn_interval_us = conn_interval_us_get(conn);

	bt_conn_unref(conn);
	conn = NULL;

	/* One notification per connection event. It is sent from the system workqueue,
	 * so that this callback stays short.
	 */
	if (test_data_notify_enabled) {
		k_work_submit(&test_data_notify_work);
	}

	if (atomic_test_and_set_bit(&last_timed_action_in_use, 0)) {
		return true;
	}

	uint64_t controller_time_us = controller_time_us_get();

	uint64_t trigger_time_local = central_timestamp_to_local_clock(
		last_timed_action.trigger_time_us_central_clock,
		conn_interval_us,
		last_timed_action.anchor_point_us_central_clock,
		evt->anchor_point_us,
		last_timed_action.anchor_point_event_counter,
		evt->event_counter);

	if (controller_time_us + 500 < trigger_time_local) {
		timed_led_toggle_trigger_at(last_timed_action.led_value, trigger_time_local);
	}

	atomic_clear_bit(&last_timed_action_in_use, 0);

	return true;
}

void peripheral_start(void)
{
	int err;

	err = bt_enable(NULL);
	if (err) {
		printk("Bluetooth init failed (err %d)\n", err);
		return;
	}

	err = bt_hci_register_vnd_evt_cb(on_vs_evt);
	if (err) {
		printk("Failed to register HCI VS callback\n");
		return;
	}

	sdc_hci_cmd_vs_conn_anchor_point_update_event_report_enable_t enable_params = {
		.enable = true
	};

	err = hci_vs_sdc_conn_anchor_point_update_event_report_enable(&enable_params);
	if (err) {
		printk("Failed to enable connection anchor point update events\n");
		return;
	}

	/* Correction for the systematic error of the peripheral trigger. */
	controller_time_trigger_offset_ns_set(PERIPHERAL_TRIGGER_CORRECTION_NS);

	timed_led_toggle_init();

	bt_conn_cb_register(&conn_callbacks);

	adv_start();
}
```
